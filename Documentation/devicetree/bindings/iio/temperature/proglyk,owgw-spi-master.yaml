## Documentation/devicetree/bindings/iio/temperature/proglyk,owgw-spi-master.yaml
```yaml
# SPDX-License-Identifier: (GPL-2.0-only OR MIT)
%YAML 1.2
---
$id: http://devicetree.org/schemas/iio/temperature/proglyk,owgw-spi-master.yaml
$schema: http://devicetree.org/meta-schemas/core.yaml

title: Proglyk OWGW SPI Master (STM32 1-Wire gateway)

maintainers:
  - Ilya Pronyashin <msg@proglyk.ru>

description: |
  SPI-attached 1-Wire gateway implemented on an STM32 slave MCU. The Linux
  master sends short command frames (see include/linux/iio/temperature/
  owgw_iface.h in the out-of-tree driver source) and the slave replies with
  status + payload + CRC-8. The driver exposes up to 16 temperature
  channels through the standard IIO sysfs ABI.

  NOTE: the driver hard-codes SPI mode 0 in owgw_probe (spi->mode =
  SPI_MODE_0). The spi-cpha / spi-cpol DT properties are intentionally
  not declared here; setting them in DT will have no effect.

allOf:
  - $ref: /schemas/spi/spi-peripheral-props.yaml#

properties:
  compatible:
    const: proglyk,owgw-spi-master

  reg:
    maxItems: 1

  spi-max-frequency:
    maximum: 10000000

  poll-interval-ms:
    description:
      Polling interval for the delayed-work sensor read, in milliseconds.
      The driver currently does NOT parse this property and always uses
      a 1000 ms default; declared here for forward compatibility.
    default: 1000
    minimum: 10
    maximum: 60000

required:
  - compatible
  - reg

unevaluatedProperties: false

examples:
  - |
    spi {
        #address-cells = <1>;
        #size-cells = <0>;

        owgw@0 {
            compatible = "proglyk,owgw-spi-master";
            reg = <0>;                              /* CS0 */
            spi-max-frequency = <10000000>;
        };
    };
```
